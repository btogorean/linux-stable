## drivers/media/spi/Kconfig
```kconfig
if VIDEO_V4L2

menu "SPI helper chips"
	visible if !MEDIA_SUBDRV_AUTOSELECT || COMPILE_TEST

config VIDEO_GS1662
	tristate "Gennum Serializers video"
	depends on SPI && VIDEO_V4L2 && VIDEO_V4L2_SUBDEV_API
	---help---
	  Enable the GS1662 driver which serializes video streams.

config VIDEO_ADDICMOS
	tristate "Analog Devices ADDICMOS ToF front-end support"
	depends on SPI && VIDEO_V4L2
	select MEDIA_CONTROLLER
	select VIDEO_V4L2_SUBDEV_API
	select V4L2_FWNODE
	select REGMAP_SPI
	help
	  This is a Video4Linux2 driver for Analog Devices ADDICMOS
	  Time of Flight front-end

	  To compile this driver as a module, choose M here: the
	  module will be called addicmos.


endmenu

endif

if SPI
menu "Media SPI Adapters"

config CXD2880_SPI_DRV
	tristate "Sony CXD2880 SPI support"
	depends on DVB_CORE && SPI
	default m if !MEDIA_SUBDRV_AUTOSELECT
	help
	  Choose if you would like to have SPI interface support for Sony CXD2880.

endmenu

endif
```
